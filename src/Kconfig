## src/Kconfig
```kconfig
menu "Eightfold Seal"
	depends on ZB_ENABLED

config OCTAVO_MAX_DOORS
	int "Number of doors supported"
	range 0 4
	default 2
	help
		Configure number of doors that are supported.

config OCTAVO_SWITCH_ACTIVE_LOW
	bool "Switches are active low"
	default n
	help
		Configure whether switch signalling is active low or high.

config OCTAVO_BUZZER_ACTIVE_LOW
	bool "Buzzer is active low"
	default n
	help
		Configure whether buzzer signalling is active low or high.

config OCTAVO_UI_LED_BRIGHTNESS
	int "RGB LED brightness"
	range 0 255
	default 8
	help
		Configure LED brightness.

config OCTAVO_ZIGBEE_ROLE_ROUTER
	bool
	default y if ZB_ZCZR

menuconfig OCTAVO_SUPPORT_OTA
	bool "Support OTA"
	default n
	help
		Support OTA (over the air) updates. These are slow and take a long time
		to complete. They're also defined in a restrictive way that expects you
		to have a Zigbee manufacturer ID (limited to 65535 values!) and wait for
		the device to pull updates from another Zigbee device/coordinator on the
		network. Updates will be marked valid automatically when a connection is
		established to a network.

if OCTAVO_SUPPORT_OTA
	config OCTAVO_OTA_MANUFACTURER_ID
		hex "Manufacturer ID"
		range 0x0000 0xfffe
		default 0
		help
			Configure Zigbee manufacturer ID for OTA updates.

	config OCTAVO_OTA_IMAGE_TYPE_ID
		hex "Image Type ID"
		range 0x0000 0xfffe
		default 0
		help
			Configure image type ID (to uniquely identify this device model)
			for OTA updates.

    config OCTAVO_OTA_FILE_VERSION_FROM_GIT_COMMIT
		bool "Use Git commit timestamp as OTA file version"
		default n
		help
			Configure the current file version (to identify which builds are
			newer) automatically using the timestamp of the current Git commit.

			This may go badly wrong while bisecting with older versions on a
			network with an upgrade server.

	config OCTAVO_OTA_FILE_VERSION
		hex "File Version"
		range 0x00000000 0xffffffff
		default 0
		depends on !OCTAVO_OTA_FILE_VERSION_FROM_GIT_COMMIT
		help
			Configure the current file version (to identify which builds are
			newer).
endif

endmenu
```
